## config/boards/shields/tk46v6/Kconfig.defconfig
```kconfig
if SHIELD_TK46V6_LEFT

config ZMK_KEYBOARD_NAME
    default "tk46v6b"

config ZMK_SPLIT_ROLE_CENTRAL
    default y

endif

if SHIELD_TK46V6_LEFT || SHIELD_TK46V6_RIGHT

config ZMK_SPLIT
    default y

endif
```

## config/boards/shields/tk46v6/Kconfig.shield
```kconfig
config SHIELD_TK46V6_LEFT
    def_bool $(shields_list_contains,tk46v6_left)

config SHIELD_TK46V6_RIGHT
    def_bool $(shields_list_contains,tk46v6_right)
```

## config/west.yml
```yaml
manifest:
  remotes:
    - name: zmkfirmware
      url-base: https://github.com/zmkfirmware
    - name: tadakado
      url-base: https://github.com/tadakado
  projects:
    - name: zmk
      remote: zmkfirmware
      revision: main
      import: app/west.yml
    # Custom modules for tk46v6b (auto-discovered as Zephyr modules via the
    # manifest -- no ZMK_EXTRA_MODULES needed).
    - name: zmk-ir
      remote: tadakado
      revision: main
    - name: zmk-rgb-indicator
      remote: tadakado
      revision: main
    - name: zmk-ble-debug
      remote: tadakado
      revision: main
    - name: zmk-bootloader-1200
      remote: tadakado
      revision: main
    - name: zmk-ble-mouse-host
      remote: tadakado
      revision: main
  self:
    path: config
```
